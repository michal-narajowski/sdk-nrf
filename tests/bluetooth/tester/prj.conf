## prj.conf
```kconfig
CONFIG_TEST=y
CONFIG_UART_PIPE=y
CONFIG_SYSTEM_WORKQUEUE_STACK_SIZE=2048
CONFIG_MAIN_STACK_SIZE=2560
CONFIG_BT_RX_STACK_SIZE=2560

CONFIG_BT=y
CONFIG_BT_CENTRAL=y
CONFIG_BT_PERIPHERAL=y
CONFIG_BT_PRIVACY=n
CONFIG_BT_SMP=y
CONFIG_BT_SMP_ENFORCE_MITM=n
CONFIG_BT_SIGNING=y
CONFIG_BT_BONDABLE=y
CONFIG_BT_ATT_PREPARE_COUNT=4
CONFIG_BT_GATT_CLIENT=y
CONFIG_BT_L2CAP_DYNAMIC_CHANNEL=y
CONFIG_BT_DEVICE_NAME="Tester"
CONFIG_BT_DEVICE_NAME_MAX=32
CONFIG_BT_DEVICE_NAME_DYNAMIC=y
CONFIG_BT_DEVICE_NAME_GATT_WRITABLE=y

CONFIG_BT_MESH=y
CONFIG_BT_MESH_RELAY=y
CONFIG_BT_MESH_PB_ADV=y
CONFIG_BT_MESH_PB_GATT=y
CONFIG_BT_MESH_LOW_POWER=y
CONFIG_BT_MESH_LPN_AUTO=n
CONFIG_BT_MESH_GATT_PROXY=y
CONFIG_BT_MESH_LABEL_COUNT=2
CONFIG_BT_MESH_SUBNET_COUNT=2
CONFIG_BT_MESH_MODEL_GROUP_COUNT=2
CONFIG_BT_MESH_APP_KEY_COUNT=4
CONFIG_BT_MESH_IV_UPDATE_TEST=y
CONFIG_BT_MESH_CFG_CLI=y
CONFIG_BT_MESH_HEALTH_CLI=y
CONFIG_BT_MESH_FRIEND=y
CONFIG_BT_MESH_FRIEND_QUEUE_SIZE=32
CONFIG_BT_MESH_RX_SEG_MAX=13
CONFIG_BT_MESH_TX_SEG_MSG_COUNT=2
CONFIG_BT_MESH_LPN_POLL_TIMEOUT=100
CONFIG_BT_MESH_TX_SEG_MAX=24
CONFIG_BT_MESH_MODEL_EXTENSIONS=y

CONFIG_BT_MESH_PLVL_SRV=y
CONFIG_BT_MESH_BATTERY_SRV=y
CONFIG_BT_MESH_LOC_SRV=y
CONFIG_BT_MESH_PROP_SRV=y
CONFIG_BT_MESH_SENSOR_SRV=y
CONFIG_BT_MESH_TIME_SRV=y
CONFIG_BT_MESH_LIGHTNESS_SRV=y
CONFIG_BT_MESH_LIGHT_CTRL_SRV=y
CONFIG_BT_MESH_SCENE_SRV=y
CONFIG_BT_MESH_LIGHT_CTL_SRV=y
CONFIG_BT_MESH_ONOFF_CLI=y
CONFIG_BT_MESH_LVL_CLI=y
CONFIG_BT_MESH_DTT_CLI=y
CONFIG_BT_MESH_PONOFF_CLI=y
CONFIG_BT_MESH_PLVL_CLI=y
CONFIG_BT_MESH_BATTERY_CLI=y
CONFIG_BT_MESH_LOC_CLI=y
CONFIG_BT_MESH_PROP_CLI=y
CONFIG_BT_MESH_SENSOR_CLI=y
CONFIG_BT_MESH_TIME_CLI=y
CONFIG_BT_MESH_LIGHTNESS_CLI=y
CONFIG_BT_MESH_LIGHT_CTRL_CLI=y
CONFIG_BT_MESH_SCENE_CLI=y
CONFIG_BT_MESH_LIGHT_CTL_CLI=y
CONFIG_BT_MESH_LIGHT_TEMP_SRV=y
CONFIG_BT_MESH_LIGHT_XYL_CLI=y
CONFIG_BT_MESH_LIGHT_XYL_SRV=y
CONFIG_BT_MESH_LIGHT_HSL_CLI=y
CONFIG_BT_MESH_LIGHT_HSL_SRV=y
CONFIG_BT_MESH_SCHEDULER_CLI=y
CONFIG_BT_MESH_SCHEDULER_SRV=y

CONFIG_BT_MESH_SCENES_MAX=10

CONFIG_BT_MESH_LIGHT_CTRL_SRV_TIME_FADE_ON=0
CONFIG_BT_MESH_LIGHT_CTRL_SRV_TIME_FADE_PROLONG=0
CONFIG_BT_MESH_LIGHT_CTRL_SRV_TIME_FADE_STANDBY_AUTO=0
CONFIG_BT_MESH_LIGHT_CTRL_SRV_TIME_FADE_STANDBY_MANUAL=0

CONFIG_SETTINGS=y
CONFIG_FLASH=y
CONFIG_FLASH_MAP=y
CONFIG_FCB=y

CONFIG_BT_TINYCRYPT_ECC=y
CONFIG_BT_TESTING=y

CONFIG_UART_CONSOLE=n
```

## src/model_handler.h
```c
/* model_handler.h - Bluetooth Mesh Models handler header */

/*
 * Copyright (c) 2021 Nordic Semiconductor ASA
 *
 * SPDX-License-Identifier: LicenseRef-Nordic-5-Clause
 */

#ifndef MODEL_HANDLER_H__
#define MODEL_HANDLER_H__

#include <bluetooth/mesh.h>

#ifdef __cplusplus
extern "C" {
#endif

#define CUR_FAULTS_MAX 4
#define HEALTH_TEST_ID 0x00

const struct bt_mesh_comp *model_handler_init(void);

extern struct bt_mesh_onoff_cli onoff_cli;
extern struct bt_mesh_lvl_cli lvl_cli;
extern struct bt_mesh_dtt_cli dtt_cli;
extern struct bt_mesh_ponoff_cli ponoff_cli;
extern struct bt_mesh_plvl_cli plvl_cli;
extern struct bt_mesh_battery_cli battery_cli;
extern struct bt_mesh_loc_cli loc_cli;
extern struct bt_mesh_prop_cli prop_cli;
extern struct bt_mesh_sensor_cli sensor_cli;
extern struct bt_mesh_time_cli time_cli;
extern struct bt_mesh_lightness_cli lightness_cli;
extern struct bt_mesh_light_ctrl_cli light_ctrl_cli;
extern struct bt_mesh_light_ctl_cli light_ctl_cli;
extern struct bt_mesh_scene_cli scene_cli;
extern struct bt_mesh_light_xyl_cli xyl_cli;
extern struct bt_mesh_light_hsl_cli light_hsl_cli;
extern struct bt_mesh_scheduler_cli scheduler_cli;

struct model_data {
	struct bt_mesh_model *model;
	uint16_t addr;
	uint16_t appkey_idx;
};

/* Model send data */
#define MODEL_BOUNDS_MAX 60

extern struct model_data model_bound[MODEL_BOUNDS_MAX];

struct net_ctx {
	uint16_t local;
	uint16_t dst;
	uint16_t net_idx;
};

extern struct net_ctx net;
void sensor_data_set(uint8_t *data, uint16_t len);

#ifdef __cplusplus
}
#endif

#endif /* MODEL_HANDLER_H__ */
```
